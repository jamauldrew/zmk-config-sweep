## build/Kconfig/Kconfig.modules
```kconfig
config ZEPHYR_HAL_STM32_MODULE
	bool
	default y

config ZEPHYR_HAL_STM32_MODULE_BLOBS
	bool
menu "lvgl (/zmk-config-sweep/modules/lib/gui/lvgl)"
osource "/zmk-config-sweep/modules/lib/gui/lvgl/zephyr/Kconfig"
config ZEPHYR_LVGL_MODULE
	bool
	default y
endmenu
config ZEPHYR_ZMK_STUDIO_MESSAGES_MODULE
	bool
	default y
menu "canopennode (/zmk-config-sweep/modules/lib/canopennode)"
osource "$(ZEPHYR_CANOPENNODE_KCONFIG)"
config ZEPHYR_CANOPENNODE_MODULE
	bool
	default y
endmenu
menu "chre (/zmk-config-sweep/modules/lib/chre)"
osource "/zmk-config-sweep/modules/lib/chre/platform/zephyr/Kconfig"
config ZEPHYR_CHRE_MODULE
	bool
	default y
endmenu
menu "lz4 (/zmk-config-sweep/modules/lib/lz4)"
osource "$(ZEPHYR_LZ4_KCONFIG)"
config ZEPHYR_LZ4_MODULE
	bool
	default y
endmenu
menu "nanopb (/zmk-config-sweep/modules/lib/nanopb)"
osource "$(ZEPHYR_NANOPB_KCONFIG)"
config ZEPHYR_NANOPB_MODULE
	bool
	default y
endmenu
config ZEPHYR_PSA_ARCH_TESTS_MODULE
	bool
	default y
menu "sof (/zmk-config-sweep/modules/audio/sof)"
osource "/zmk-config-sweep/modules/audio/sof/zephyr/Kconfig"
config ZEPHYR_SOF_MODULE
	bool
	default y
endmenu
config ZEPHYR_TF_M_TESTS_MODULE
	bool
	default y
menu "tflite-micro (/zmk-config-sweep/optional/modules/lib/tflite-micro)"
osource "$(ZEPHYR_TFLITE_MICRO_KCONFIG)"
config ZEPHYR_TFLITE_MICRO_MODULE
	bool
	default y
endmenu
menu "thrift (/zmk-config-sweep/optional/modules/lib/thrift)"
osource "$(ZEPHYR_THRIFT_KCONFIG)"
config ZEPHYR_THRIFT_MODULE
	bool
	default y
endmenu
menu "lang-rust (/zmk-config-sweep/modules/lang/rust)"
osource "/zmk-config-sweep/modules/lang/rust/Kconfig"
config ZEPHYR_LANG_RUST_MODULE
	bool
	default y
endmenu
menu "zscilib (/zmk-config-sweep/modules/lib/zscilib)"
osource "/zmk-config-sweep/modules/lib/zscilib/Kconfig.zscilib"
config ZEPHYR_ZSCILIB_MODULE
	bool
	default y
endmenu
menu "acpica (/zmk-config-sweep/modules/lib/acpica)"
osource "$(ZEPHYR_ACPICA_KCONFIG)"
config ZEPHYR_ACPICA_MODULE
	bool
	default y
endmenu
menu "cmsis (/zmk-config-sweep/modules/hal/cmsis)"
osource "$(ZEPHYR_CMSIS_KCONFIG)"
config ZEPHYR_CMSIS_MODULE
	bool
	default y
endmenu
menu "cmsis-dsp (/zmk-config-sweep/modules/lib/cmsis-dsp)"
osource "$(ZEPHYR_CMSIS_DSP_KCONFIG)"
config ZEPHYR_CMSIS_DSP_MODULE
	bool
	default y
endmenu
menu "cmsis-nn (/zmk-config-sweep/modules/lib/cmsis-nn)"
osource "$(ZEPHYR_CMSIS_NN_KCONFIG)"
config ZEPHYR_CMSIS_NN_MODULE
	bool
	default y
endmenu
menu "fatfs (/zmk-config-sweep/modules/fs/fatfs)"
osource "$(ZEPHYR_FATFS_KCONFIG)"
config ZEPHYR_FATFS_MODULE
	bool
	default y
endmenu
config ZEPHYR_ADI_MODULE
	bool
	default y
menu "hal_ambiq (/zmk-config-sweep/modules/hal/ambiq)"
osource "$(ZEPHYR_HAL_AMBIQ_KCONFIG)"
config ZEPHYR_HAL_AMBIQ_MODULE
	bool
	default y
endmenu
config ZEPHYR_ATMEL_MODULE
	bool
	default y
menu "hal_espressif (/zmk-config-sweep/modules/hal/espressif)"
osource "/zmk-config-sweep/modules/hal/espressif/zephyr/Kconfig"
config ZEPHYR_HAL_ESPRESSIF_MODULE
	bool
	default y

config ZEPHYR_HAL_ESPRESSIF_MODULE_BLOBS
	bool
endmenu
menu "hal_ethos_u (/zmk-config-sweep/modules/hal/ethos_u)"
osource "$(ZEPHYR_HAL_ETHOS_U_KCONFIG)"
config ZEPHYR_HAL_ETHOS_U_MODULE
	bool
	default y
endmenu
menu "hal_gigadevice (/zmk-config-sweep/modules/hal/gigadevice)"
osource "$(ZEPHYR_HAL_GIGADEVICE_KCONFIG)"
config ZEPHYR_HAL_GIGADEVICE_MODULE
	bool
	default y
endmenu
menu "hal_intel (/zmk-config-sweep/modules/hal/intel)"
osource "/zmk-config-sweep/modules/hal/intel/zephyr/Kconfig"
config ZEPHYR_HAL_INTEL_MODULE
	bool
	default y
endmenu
menu "hal_nordic (/zmk-config-sweep/modules/hal/nordic)"
osource "$(ZEPHYR_HAL_NORDIC_KCONFIG)"
config ZEPHYR_HAL_NORDIC_MODULE
	bool
	default y

config ZEPHYR_HAL_NORDIC_MODULE_BLOBS
	bool
endmenu
config ZEPHYR_NUVOTON_MODULE
	bool
	default y
config ZEPHYR_QUICKLOGIC_MODULE
	bool
	default y
config ZEPHYR_HAL_RENESAS_MODULE
	bool
	default y

config ZEPHYR_HAL_RENESAS_MODULE_BLOBS
	bool
menu "hal_rpi_pico (/zmk-config-sweep/modules/hal/rpi_pico)"
osource "$(ZEPHYR_HAL_RPI_PICO_KCONFIG)"
config ZEPHYR_HAL_RPI_PICO_MODULE
	bool
	default y
endmenu
menu "hal_silabs (/zmk-config-sweep/modules/hal/silabs)"
osource "$(ZEPHYR_HAL_SILABS_KCONFIG)"
config ZEPHYR_HAL_SILABS_MODULE
	bool
	default y

config ZEPHYR_HAL_SILABS_MODULE_BLOBS
	bool
endmenu
menu "hal_tdk (/zmk-config-sweep/modules/hal/tdk)"
osource "$(ZEPHYR_HAL_TDK_KCONFIG)"
config ZEPHYR_HAL_TDK_MODULE
	bool
	default y
endmenu
menu "hal_telink (/zmk-config-sweep/modules/hal/telink)"
osource "/zmk-config-sweep/modules/hal/telink/Kconfig"
config ZEPHYR_HAL_TELINK_MODULE
	bool
	default y
endmenu
menu "hal_wch (/zmk-config-sweep/modules/hal/wch)"
osource "$(ZEPHYR_HAL_WCH_KCONFIG)"
config ZEPHYR_HAL_WCH_MODULE
	bool
	default y
endmenu
config ZEPHYR_HAL_WURTHELEKTRONIK_MODULE
	bool
	default y
menu "hostap (/zmk-config-sweep/modules/lib/hostap)"
osource "$(ZEPHYR_HOSTAP_KCONFIG)"
config ZEPHYR_HOSTAP_MODULE
	bool
	default y
endmenu
menu "liblc3 (/zmk-config-sweep/modules/lib/liblc3)"
osource "$(ZEPHYR_LIBLC3_KCONFIG)"
config ZEPHYR_LIBLC3_MODULE
	bool
	default y
endmenu
config ZEPHYR_LIBMCTP_MODULE
	bool
	default y
config ZEPHYR_LIBMETAL_MODULE
	bool
	default y
menu "littlefs (/zmk-config-sweep/modules/fs/littlefs)"
osource "$(ZEPHYR_LITTLEFS_KCONFIG)"
config ZEPHYR_LITTLEFS_MODULE
	bool
	default y
endmenu
menu "mbedtls (/zmk-config-sweep/modules/crypto/mbedtls)"
osource "$(ZEPHYR_MBEDTLS_KCONFIG)"
config ZEPHYR_MBEDTLS_MODULE
	bool
	default y
endmenu
config ZEPHYR_MIPI_SYS_T_MODULE
	bool
	default y
menu "nrf_wifi (/zmk-config-sweep/modules/lib/nrf_wifi)"
osource "$(ZEPHYR_NRF_WIFI_KCONFIG)"
config ZEPHYR_NRF_WIFI_MODULE
	bool
	default y

config ZEPHYR_NRF_WIFI_MODULE_BLOBS
	bool
endmenu
config ZEPHYR_OPEN_AMP_MODULE
	bool
	default y
menu "percepio (/zmk-config-sweep/modules/debug/percepio)"
osource "/zmk-config-sweep/modules/debug/percepio/zephyr/Kconfig"
config ZEPHYR_PERCEPIO_MODULE
	bool
	default y
endmenu
menu "picolibc (/zmk-config-sweep/modules/lib/picolibc)"
osource "/zmk-config-sweep/modules/lib/picolibc/zephyr/Kconfig"
config ZEPHYR_PICOLIBC_MODULE
	bool
	default y
endmenu
menu "segger (/zmk-config-sweep/modules/debug/segger)"
osource "$(ZEPHYR_SEGGER_KCONFIG)"
config ZEPHYR_SEGGER_MODULE
	bool
	default y
endmenu
config ZEPHYR_TINYCRYPT_MODULE
	bool
	default y
menu "trusted-firmware-a (/zmk-config-sweep/modules/tee/tf-a/trusted-firmware-a)"
osource "$(ZEPHYR_TRUSTED_FIRMWARE_A_KCONFIG)"
config ZEPHYR_TRUSTED_FIRMWARE_A_MODULE
	bool
	default y
endmenu
menu "uoscore-uedhoc (/zmk-config-sweep/modules/lib/uoscore-uedhoc)"
osource "$(ZEPHYR_UOSCORE_UEDHOC_KCONFIG)"
config ZEPHYR_UOSCORE_UEDHOC_MODULE
	bool
	default y
endmenu
menu "zcbor (/zmk-config-sweep/modules/lib/zcbor)"
osource "$(ZEPHYR_ZCBOR_KCONFIG)"
config ZEPHYR_ZCBOR_MODULE
	bool
	default y
endmenu
menu "module (/zmk-config-sweep/zmk/app/module)"
osource "/zmk-config-sweep/zmk/app/module/Kconfig"
config ZEPHYR_MODULE_MODULE
	bool
	default y
endmenu
config ZEPHYR_KEYMAP_MODULE_MODULE
	bool
	default y
config ZEPHYR_NRF_HW_MODELS_MODULE
	bool
	default y
```

## build/Kconfig/Kconfig.shield
```kconfig
osource "/zmk-config-sweep/zmk/app/module/boards/shields/*/Kconfig.shield"
osource "/zmk-config-sweep/zmk/app/boards/shields/*/Kconfig.shield"
```

## build/Kconfig/Kconfig.shield.defconfig
```kconfig
osource "/zmk-config-sweep/zmk/app/module/boards/shields/*/Kconfig.defconfig"
osource "/zmk-config-sweep/zmk/app/boards/shields/*/Kconfig.defconfig"
```

## build/Kconfig/arch/Kconfig
```kconfig
# Load Zephyr Arch Kconfig descriptions.
osource "/zmk-config-sweep/zephyr/arch/x86/Kconfig"
osource "/zmk-config-sweep/zephyr/arch/xtensa/Kconfig"
osource "/zmk-config-sweep/zephyr/arch/sparc/Kconfig"
osource "/zmk-config-sweep/zephyr/arch/riscv/Kconfig"
osource "/zmk-config-sweep/zephyr/arch/posix/Kconfig"
osource "/zmk-config-sweep/zephyr/arch/nios2/Kconfig"
osource "/zmk-config-sweep/zephyr/arch/mips/Kconfig"
osource "/zmk-config-sweep/zephyr/arch/arm64/Kconfig"
osource "/zmk-config-sweep/zephyr/arch/arm/Kconfig"
osource "/zmk-config-sweep/zephyr/arch/arc/Kconfig"
```

## build/Kconfig/boards/Kconfig
```kconfig
# Load Zephyr board Kconfig descriptions.
osource "/zmk-config-sweep/zmk/app/module/boards/nicekeyboards/nice_nano/Kconfig"
osource "/zmk-config-sweep/zmk/app/boards/nicekeyboards/nice_nano/Kconfig"
```

## build/Kconfig/boards/Kconfig.defconfig
```kconfig
# Load Zephyr board defconfig descriptions.
osource "/zmk-config-sweep/zmk/app/module/boards/nicekeyboards/nice_nano/Kconfig.defconfig"
osource "/zmk-config-sweep/zmk/app/boards/nicekeyboards/nice_nano/Kconfig.defconfig"
```

## build/Kconfig/boards/Kconfig.nice_nano
```kconfig
# Load board Kconfig descriptions.
osource "/zmk-config-sweep/zmk/app/module/boards/nicekeyboards/nice_nano/Kconfig.nice_nano"
osource "/zmk-config-sweep/zmk/app/boards/nicekeyboards/nice_nano/Kconfig.nice_nano"
```

## build/Kconfig/boards/Kconfig.sysbuild
```kconfig
# Load Sysbuild board Kconfig descriptions.
osource "/zmk-config-sweep/zmk/app/module/boards/nicekeyboards/nice_nano/Kconfig.sysbuild"
osource "/zmk-config-sweep/zmk/app/boards/nicekeyboards/nice_nano/Kconfig.sysbuild"
```

## build/Kconfig/soc/Kconfig
```kconfig
# Load Zephyr SoC Kconfig descriptions.
osource "/zmk-config-sweep/zephyr/soc/xlnx/zynqmp/Kconfig"
osource "/zmk-config-sweep/zephyr/soc/xlnx/zynq7000/Kconfig"
osource "/zmk-config-sweep/zephyr/soc/xen/Kconfig"
osource "/zmk-config-sweep/zephyr/soc/wch/ch32v/Kconfig"
osource "/zmk-config-sweep/zephyr/soc/ti/simplelink/Kconfig"
osource "/zmk-config-sweep/zephyr/soc/ti/lm3s6965/Kconfig"
osource "/zmk-config-sweep/zephyr/soc/ti/k3/Kconfig"
osource "/zmk-config-sweep/zephyr/soc/telink/tlsr/Kconfig"
osource "/zmk-config-sweep/zephyr/soc/starfive/jh71xx/Kconfig"
osource "/zmk-config-sweep/zephyr/soc/st/stm32/Kconfig"
osource "/zmk-config-sweep/zephyr/soc/snps/qemu_arc/Kconfig"
osource "/zmk-config-sweep/zephyr/soc/snps/nsim/arc_v/Kconfig"
osource "/zmk-config-sweep/zephyr/soc/snps/nsim/arc_classic/Kconfig"
osource "/zmk-config-sweep/zephyr/soc/snps/hsdk4xd/Kconfig"
osource "/zmk-config-sweep/zephyr/soc/snps/hsdk/Kconfig"
osource "/zmk-config-sweep/zephyr/soc/snps/emsk/Kconfig"
osource "/zmk-config-sweep/zephyr/soc/snps/emsdp/Kconfig"
osource "/zmk-config-sweep/zephyr/soc/snps/arc_iot/Kconfig"
osource "/zmk-config-sweep/zephyr/soc/silabs/Kconfig"
osource "/zmk-config-sweep/zephyr/soc/sifive/sifive_freedom/Kconfig"
osource "/zmk-config-sweep/zephyr/soc/sensry/Kconfig"
osource "/zmk-config-sweep/zephyr/soc/rockchip/Kconfig"
osource "/zmk-config-sweep/zephyr/soc/renode/riscv_virtual/Kconfig"
osource "/zmk-config-sweep/zephyr/soc/renode/cortex_r8_virtual/Kconfig"
osource "/zmk-config-sweep/zephyr/soc/renesas/smartbond/Kconfig"
osource "/zmk-config-sweep/zephyr/soc/renesas/rzt2m/Kconfig"
osource "/zmk-config-sweep/zephyr/soc/renesas/rz/Kconfig"
osource "/zmk-config-sweep/zephyr/soc/renesas/rcar/Kconfig"
osource "/zmk-config-sweep/zephyr/soc/renesas/ra/Kconfig"
osource "/zmk-config-sweep/zephyr/soc/realtek/ec/Kconfig"
osource "/zmk-config-sweep/zephyr/soc/raspberrypi/rpi_pico/Kconfig"
osource "/zmk-config-sweep/zephyr/soc/quicklogic/eos_s3/Kconfig"
osource "/zmk-config-sweep/zephyr/soc/qemu/virt_riscv/Kconfig"
osource "/zmk-config-sweep/zephyr/soc/qemu/malta/Kconfig"
osource "/zmk-config-sweep/zephyr/soc/openisa/rv32m1/Kconfig"
osource "/zmk-config-sweep/zephyr/soc/nxp/s32/Kconfig"
osource "/zmk-config-sweep/zephyr/soc/nxp/rw/Kconfig"
osource "/zmk-config-sweep/zephyr/soc/nxp/mcx/Kconfig"
osource "/zmk-config-sweep/zephyr/soc/nxp/lpc/Kconfig"
osource "/zmk-config-sweep/zephyr/soc/nxp/layerscape/Kconfig"
osource "/zmk-config-sweep/zephyr/soc/nxp/kinetis/Kconfig"
osource "/zmk-config-sweep/zephyr/soc/nxp/imxrt/Kconfig"
osource "/zmk-config-sweep/zephyr/soc/nxp/imx/Kconfig"
osource "/zmk-config-sweep/zephyr/soc/nuvoton/numicro/Kconfig"
osource "/zmk-config-sweep/zephyr/soc/nuvoton/numaker/Kconfig"
osource "/zmk-config-sweep/zephyr/soc/nuvoton/npcx/Kconfig"
osource "/zmk-config-sweep/zephyr/soc/nuvoton/npcm/Kconfig"
osource "/zmk-config-sweep/zephyr/soc/nordic/Kconfig"
osource "/zmk-config-sweep/zephyr/soc/neorv32/Kconfig"
osource "/zmk-config-sweep/zephyr/soc/native/inf_clock/Kconfig"
osource "/zmk-config-sweep/zephyr/soc/microchip/miv/Kconfig"
osource "/zmk-config-sweep/zephyr/soc/microchip/mec/Kconfig"
osource "/zmk-config-sweep/zephyr/soc/mediatek/mt8xxx/Kconfig"
osource "/zmk-config-sweep/zephyr/soc/lowrisc/opentitan/Kconfig"
osource "/zmk-config-sweep/zephyr/soc/litex/litex_vexriscv/Kconfig"
osource "/zmk-config-sweep/zephyr/soc/ite/ec/Kconfig"
osource "/zmk-config-sweep/zephyr/soc/intel/raptor_lake/Kconfig"
osource "/zmk-config-sweep/zephyr/soc/intel/lakemont/Kconfig"
osource "/zmk-config-sweep/zephyr/soc/intel/intel_socfpga_std/Kconfig"
osource "/zmk-config-sweep/zephyr/soc/intel/intel_socfpga/Kconfig"
osource "/zmk-config-sweep/zephyr/soc/intel/intel_niosv/Kconfig"
osource "/zmk-config-sweep/zephyr/soc/intel/intel_ish/Kconfig"
osource "/zmk-config-sweep/zephyr/soc/intel/intel_adsp/Kconfig"
osource "/zmk-config-sweep/zephyr/soc/intel/elkhart_lake/Kconfig"
osource "/zmk-config-sweep/zephyr/soc/intel/atom/Kconfig"
osource "/zmk-config-sweep/zephyr/soc/intel/apollo_lake/Kconfig"
osource "/zmk-config-sweep/zephyr/soc/intel/alder_lake/Kconfig"
osource "/zmk-config-sweep/zephyr/soc/infineon/cat3/Kconfig"
osource "/zmk-config-sweep/zephyr/soc/infineon/cat1b/Kconfig"
osource "/zmk-config-sweep/zephyr/soc/infineon/cat1a/Kconfig"
osource "/zmk-config-sweep/zephyr/soc/gd/gd32/Kconfig"
osource "/zmk-config-sweep/zephyr/soc/gaisler/leon3/Kconfig"
osource "/zmk-config-sweep/zephyr/soc/gaisler/gr716a/Kconfig"
osource "/zmk-config-sweep/zephyr/soc/espressif/Kconfig"
osource "/zmk-config-sweep/zephyr/soc/ene/kb1200/Kconfig"
osource "/zmk-config-sweep/zephyr/soc/efinix/sapphire/Kconfig"
osource "/zmk-config-sweep/zephyr/soc/cdns/xtensa_sample_controller/Kconfig"
osource "/zmk-config-sweep/zephyr/soc/cdns/sample_controller32/Kconfig"
osource "/zmk-config-sweep/zephyr/soc/cdns/dc233c/Kconfig"
osource "/zmk-config-sweep/zephyr/soc/brcm/bcmvk/Kconfig"
osource "/zmk-config-sweep/zephyr/soc/brcm/bcm2712/Kconfig"
osource "/zmk-config-sweep/zephyr/soc/brcm/bcm2711/Kconfig"
osource "/zmk-config-sweep/zephyr/soc/atmel/sam0/Kconfig"
osource "/zmk-config-sweep/zephyr/soc/atmel/sam/Kconfig"
osource "/zmk-config-sweep/zephyr/soc/aspeed/Kconfig"
osource "/zmk-config-sweep/zephyr/soc/arm/Kconfig"
osource "/zmk-config-sweep/zephyr/soc/arm/beetle/Kconfig"
osource "/zmk-config-sweep/zephyr/soc/antmicro/myra/Kconfig"
osource "/zmk-config-sweep/zephyr/soc/andestech/Kconfig"
osource "/zmk-config-sweep/zephyr/soc/amd/acp_6_0/Kconfig"
osource "/zmk-config-sweep/zephyr/soc/ambiq/Kconfig"
osource "/zmk-config-sweep/zephyr/soc/altr/zephyr_nios2f/Kconfig"
osource "/zmk-config-sweep/zephyr/soc/altr/qemu_nios2/Kconfig"
osource "/zmk-config-sweep/zephyr/soc/adi/max32/Kconfig"
```
