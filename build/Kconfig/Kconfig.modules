## build/Kconfig/soc/Kconfig.sysbuild
```kconfig
# Load Sysbuild SoC Kconfig descriptions.
osource "/zmk-config-sweep/zephyr/soc/xlnx/zynqmp/Kconfig.sysbuild"
osource "/zmk-config-sweep/zephyr/soc/xlnx/zynq7000/Kconfig.sysbuild"
osource "/zmk-config-sweep/zephyr/soc/xen/Kconfig.sysbuild"
osource "/zmk-config-sweep/zephyr/soc/wch/ch32v/Kconfig.sysbuild"
osource "/zmk-config-sweep/zephyr/soc/ti/simplelink/Kconfig.sysbuild"
osource "/zmk-config-sweep/zephyr/soc/ti/lm3s6965/Kconfig.sysbuild"
osource "/zmk-config-sweep/zephyr/soc/ti/k3/Kconfig.sysbuild"
osource "/zmk-config-sweep/zephyr/soc/telink/tlsr/Kconfig.sysbuild"
osource "/zmk-config-sweep/zephyr/soc/starfive/jh71xx/Kconfig.sysbuild"
osource "/zmk-config-sweep/zephyr/soc/st/stm32/Kconfig.sysbuild"
osource "/zmk-config-sweep/zephyr/soc/snps/qemu_arc/Kconfig.sysbuild"
osource "/zmk-config-sweep/zephyr/soc/snps/nsim/arc_v/Kconfig.sysbuild"
osource "/zmk-config-sweep/zephyr/soc/snps/nsim/arc_classic/Kconfig.sysbuild"
osource "/zmk-config-sweep/zephyr/soc/snps/hsdk4xd/Kconfig.sysbuild"
osource "/zmk-config-sweep/zephyr/soc/snps/hsdk/Kconfig.sysbuild"
osource "/zmk-config-sweep/zephyr/soc/snps/emsk/Kconfig.sysbuild"
osource "/zmk-config-sweep/zephyr/soc/snps/emsdp/Kconfig.sysbuild"
osource "/zmk-config-sweep/zephyr/soc/snps/arc_iot/Kconfig.sysbuild"
osource "/zmk-config-sweep/zephyr/soc/silabs/Kconfig.sysbuild"
osource "/zmk-config-sweep/zephyr/soc/sifive/sifive_freedom/Kconfig.sysbuild"
osource "/zmk-config-sweep/zephyr/soc/sensry/Kconfig.sysbuild"
osource "/zmk-config-sweep/zephyr/soc/rockchip/Kconfig.sysbuild"
osource "/zmk-config-sweep/zephyr/soc/renode/riscv_virtual/Kconfig.sysbuild"
osource "/zmk-config-sweep/zephyr/soc/renode/cortex_r8_virtual/Kconfig.sysbuild"
osource "/zmk-config-sweep/zephyr/soc/renesas/smartbond/Kconfig.sysbuild"
osource "/zmk-config-sweep/zephyr/soc/renesas/rzt2m/Kconfig.sysbuild"
osource "/zmk-config-sweep/zephyr/soc/renesas/rz/Kconfig.sysbuild"
osource "/zmk-config-sweep/zephyr/soc/renesas/rcar/Kconfig.sysbuild"
osource "/zmk-config-sweep/zephyr/soc/renesas/ra/Kconfig.sysbuild"
osource "/zmk-config-sweep/zephyr/soc/realtek/ec/Kconfig.sysbuild"
osource "/zmk-config-sweep/zephyr/soc/raspberrypi/rpi_pico/Kconfig.sysbuild"
osource "/zmk-config-sweep/zephyr/soc/quicklogic/eos_s3/Kconfig.sysbuild"
osource "/zmk-config-sweep/zephyr/soc/qemu/virt_riscv/Kconfig.sysbuild"
osource "/zmk-config-sweep/zephyr/soc/qemu/malta/Kconfig.sysbuild"
osource "/zmk-config-sweep/zephyr/soc/openisa/rv32m1/Kconfig.sysbuild"
osource "/zmk-config-sweep/zephyr/soc/nxp/s32/Kconfig.sysbuild"
osource "/zmk-config-sweep/zephyr/soc/nxp/rw/Kconfig.sysbuild"
osource "/zmk-config-sweep/zephyr/soc/nxp/mcx/Kconfig.sysbuild"
osource "/zmk-config-sweep/zephyr/soc/nxp/lpc/Kconfig.sysbuild"
osource "/zmk-config-sweep/zephyr/soc/nxp/layerscape/Kconfig.sysbuild"
osource "/zmk-config-sweep/zephyr/soc/nxp/kinetis/Kconfig.sysbuild"
osource "/zmk-config-sweep/zephyr/soc/nxp/imxrt/Kconfig.sysbuild"
osource "/zmk-config-sweep/zephyr/soc/nxp/imx/Kconfig.sysbuild"
osource "/zmk-config-sweep/zephyr/soc/nuvoton/numicro/Kconfig.sysbuild"
osource "/zmk-config-sweep/zephyr/soc/nuvoton/numaker/Kconfig.sysbuild"
osource "/zmk-config-sweep/zephyr/soc/nuvoton/npcx/Kconfig.sysbuild"
osource "/zmk-config-sweep/zephyr/soc/nuvoton/npcm/Kconfig.sysbuild"
osource "/zmk-config-sweep/zephyr/soc/nordic/Kconfig.sysbuild"
osource "/zmk-config-sweep/zephyr/soc/neorv32/Kconfig.sysbuild"
osource "/zmk-config-sweep/zephyr/soc/native/inf_clock/Kconfig.sysbuild"
osource "/zmk-config-sweep/zephyr/soc/microchip/miv/Kconfig.sysbuild"
osource "/zmk-config-sweep/zephyr/soc/microchip/mec/Kconfig.sysbuild"
osource "/zmk-config-sweep/zephyr/soc/mediatek/mt8xxx/Kconfig.sysbuild"
osource "/zmk-config-sweep/zephyr/soc/lowrisc/opentitan/Kconfig.sysbuild"
osource "/zmk-config-sweep/zephyr/soc/litex/litex_vexriscv/Kconfig.sysbuild"
osource "/zmk-config-sweep/zephyr/soc/ite/ec/Kconfig.sysbuild"
osource "/zmk-config-sweep/zephyr/soc/intel/raptor_lake/Kconfig.sysbuild"
osource "/zmk-config-sweep/zephyr/soc/intel/lakemont/Kconfig.sysbuild"
osource "/zmk-config-sweep/zephyr/soc/intel/intel_socfpga_std/Kconfig.sysbuild"
osource "/zmk-config-sweep/zephyr/soc/intel/intel_socfpga/Kconfig.sysbuild"
osource "/zmk-config-sweep/zephyr/soc/intel/intel_niosv/Kconfig.sysbuild"
osource "/zmk-config-sweep/zephyr/soc/intel/intel_ish/Kconfig.sysbuild"
osource "/zmk-config-sweep/zephyr/soc/intel/intel_adsp/Kconfig.sysbuild"
osource "/zmk-config-sweep/zephyr/soc/intel/elkhart_lake/Kconfig.sysbuild"
osource "/zmk-config-sweep/zephyr/soc/intel/atom/Kconfig.sysbuild"
osource "/zmk-config-sweep/zephyr/soc/intel/apollo_lake/Kconfig.sysbuild"
osource "/zmk-config-sweep/zephyr/soc/intel/alder_lake/Kconfig.sysbuild"
osource "/zmk-config-sweep/zephyr/soc/infineon/cat3/Kconfig.sysbuild"
osource "/zmk-config-sweep/zephyr/soc/infineon/cat1b/Kconfig.sysbuild"
osource "/zmk-config-sweep/zephyr/soc/infineon/cat1a/Kconfig.sysbuild"
osource "/zmk-config-sweep/zephyr/soc/gd/gd32/Kconfig.sysbuild"
osource "/zmk-config-sweep/zephyr/soc/gaisler/leon3/Kconfig.sysbuild"
osource "/zmk-config-sweep/zephyr/soc/gaisler/gr716a/Kconfig.sysbuild"
osource "/zmk-config-sweep/zephyr/soc/espressif/Kconfig.sysbuild"
osource "/zmk-config-sweep/zephyr/soc/ene/kb1200/Kconfig.sysbuild"
osource "/zmk-config-sweep/zephyr/soc/efinix/sapphire/Kconfig.sysbuild"
osource "/zmk-config-sweep/zephyr/soc/cdns/xtensa_sample_controller/Kconfig.sysbuild"
osource "/zmk-config-sweep/zephyr/soc/cdns/sample_controller32/Kconfig.sysbuild"
osource "/zmk-config-sweep/zephyr/soc/cdns/dc233c/Kconfig.sysbuild"
osource "/zmk-config-sweep/zephyr/soc/brcm/bcmvk/Kconfig.sysbuild"
osource "/zmk-config-sweep/zephyr/soc/brcm/bcm2712/Kconfig.sysbuild"
osource "/zmk-config-sweep/zephyr/soc/brcm/bcm2711/Kconfig.sysbuild"
osource "/zmk-config-sweep/zephyr/soc/atmel/sam0/Kconfig.sysbuild"
osource "/zmk-config-sweep/zephyr/soc/atmel/sam/Kconfig.sysbuild"
osource "/zmk-config-sweep/zephyr/soc/aspeed/Kconfig.sysbuild"
osource "/zmk-config-sweep/zephyr/soc/arm/Kconfig.sysbuild"
osource "/zmk-config-sweep/zephyr/soc/arm/beetle/Kconfig.sysbuild"
osource "/zmk-config-sweep/zephyr/soc/antmicro/myra/Kconfig.sysbuild"
osource "/zmk-config-sweep/zephyr/soc/andestech/Kconfig.sysbuild"
osource "/zmk-config-sweep/zephyr/soc/amd/acp_6_0/Kconfig.sysbuild"
osource "/zmk-config-sweep/zephyr/soc/ambiq/Kconfig.sysbuild"
osource "/zmk-config-sweep/zephyr/soc/altr/zephyr_nios2f/Kconfig.sysbuild"
osource "/zmk-config-sweep/zephyr/soc/altr/qemu_nios2/Kconfig.sysbuild"
osource "/zmk-config-sweep/zephyr/soc/adi/max32/Kconfig.sysbuild"
```
