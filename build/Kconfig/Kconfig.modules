## build/Kconfig/soc/Kconfig.defconfig
```kconfig
# Load Zephyr SoC defconfig descriptions.
osource "/zmk-config-sweep/zephyr/soc/xlnx/zynqmp/Kconfig.defconfig"
osource "/zmk-config-sweep/zephyr/soc/xlnx/zynq7000/Kconfig.defconfig"
osource "/zmk-config-sweep/zephyr/soc/xen/Kconfig.defconfig"
osource "/zmk-config-sweep/zephyr/soc/wch/ch32v/Kconfig.defconfig"
osource "/zmk-config-sweep/zephyr/soc/ti/simplelink/Kconfig.defconfig"
osource "/zmk-config-sweep/zephyr/soc/ti/lm3s6965/Kconfig.defconfig"
osource "/zmk-config-sweep/zephyr/soc/ti/k3/Kconfig.defconfig"
osource "/zmk-config-sweep/zephyr/soc/telink/tlsr/Kconfig.defconfig"
osource "/zmk-config-sweep/zephyr/soc/starfive/jh71xx/Kconfig.defconfig"
osource "/zmk-config-sweep/zephyr/soc/st/stm32/Kconfig.defconfig"
osource "/zmk-config-sweep/zephyr/soc/snps/qemu_arc/Kconfig.defconfig"
osource "/zmk-config-sweep/zephyr/soc/snps/nsim/arc_v/Kconfig.defconfig"
osource "/zmk-config-sweep/zephyr/soc/snps/nsim/arc_classic/Kconfig.defconfig"
osource "/zmk-config-sweep/zephyr/soc/snps/hsdk4xd/Kconfig.defconfig"
osource "/zmk-config-sweep/zephyr/soc/snps/hsdk/Kconfig.defconfig"
osource "/zmk-config-sweep/zephyr/soc/snps/emsk/Kconfig.defconfig"
osource "/zmk-config-sweep/zephyr/soc/snps/emsdp/Kconfig.defconfig"
osource "/zmk-config-sweep/zephyr/soc/snps/arc_iot/Kconfig.defconfig"
osource "/zmk-config-sweep/zephyr/soc/silabs/Kconfig.defconfig"
osource "/zmk-config-sweep/zephyr/soc/sifive/sifive_freedom/Kconfig.defconfig"
osource "/zmk-config-sweep/zephyr/soc/sensry/Kconfig.defconfig"
osource "/zmk-config-sweep/zephyr/soc/rockchip/Kconfig.defconfig"
osource "/zmk-config-sweep/zephyr/soc/renode/riscv_virtual/Kconfig.defconfig"
osource "/zmk-config-sweep/zephyr/soc/renode/cortex_r8_virtual/Kconfig.defconfig"
osource "/zmk-config-sweep/zephyr/soc/renesas/smartbond/Kconfig.defconfig"
osource "/zmk-config-sweep/zephyr/soc/renesas/rzt2m/Kconfig.defconfig"
osource "/zmk-config-sweep/zephyr/soc/renesas/rz/Kconfig.defconfig"
osource "/zmk-config-sweep/zephyr/soc/renesas/rcar/Kconfig.defconfig"
osource "/zmk-config-sweep/zephyr/soc/renesas/ra/Kconfig.defconfig"
osource "/zmk-config-sweep/zephyr/soc/realtek/ec/Kconfig.defconfig"
osource "/zmk-config-sweep/zephyr/soc/raspberrypi/rpi_pico/Kconfig.defconfig"
osource "/zmk-config-sweep/zephyr/soc/quicklogic/eos_s3/Kconfig.defconfig"
osource "/zmk-config-sweep/zephyr/soc/qemu/virt_riscv/Kconfig.defconfig"
osource "/zmk-config-sweep/zephyr/soc/qemu/malta/Kconfig.defconfig"
osource "/zmk-config-sweep/zephyr/soc/openisa/rv32m1/Kconfig.defconfig"
osource "/zmk-config-sweep/zephyr/soc/nxp/s32/Kconfig.defconfig"
osource "/zmk-config-sweep/zephyr/soc/nxp/rw/Kconfig.defconfig"
osource "/zmk-config-sweep/zephyr/soc/nxp/mcx/Kconfig.defconfig"
osource "/zmk-config-sweep/zephyr/soc/nxp/lpc/Kconfig.defconfig"
osource "/zmk-config-sweep/zephyr/soc/nxp/layerscape/Kconfig.defconfig"
osource "/zmk-config-sweep/zephyr/soc/nxp/kinetis/Kconfig.defconfig"
osource "/zmk-config-sweep/zephyr/soc/nxp/imxrt/Kconfig.defconfig"
osource "/zmk-config-sweep/zephyr/soc/nxp/imx/Kconfig.defconfig"
osource "/zmk-config-sweep/zephyr/soc/nuvoton/numicro/Kconfig.defconfig"
osource "/zmk-config-sweep/zephyr/soc/nuvoton/numaker/Kconfig.defconfig"
osource "/zmk-config-sweep/zephyr/soc/nuvoton/npcx/Kconfig.defconfig"
osource "/zmk-config-sweep/zephyr/soc/nuvoton/npcm/Kconfig.defconfig"
osource "/zmk-config-sweep/zephyr/soc/nordic/Kconfig.defconfig"
osource "/zmk-config-sweep/zephyr/soc/neorv32/Kconfig.defconfig"
osource "/zmk-config-sweep/zephyr/soc/native/inf_clock/Kconfig.defconfig"
osource "/zmk-config-sweep/zephyr/soc/microchip/miv/Kconfig.defconfig"
osource "/zmk-config-sweep/zephyr/soc/microchip/mec/Kconfig.defconfig"
osource "/zmk-config-sweep/zephyr/soc/mediatek/mt8xxx/Kconfig.defconfig"
osource "/zmk-config-sweep/zephyr/soc/lowrisc/opentitan/Kconfig.defconfig"
osource "/zmk-config-sweep/zephyr/soc/litex/litex_vexriscv/Kconfig.defconfig"
osource "/zmk-config-sweep/zephyr/soc/ite/ec/Kconfig.defconfig"
osource "/zmk-config-sweep/zephyr/soc/intel/raptor_lake/Kconfig.defconfig"
osource "/zmk-config-sweep/zephyr/soc/intel/lakemont/Kconfig.defconfig"
osource "/zmk-config-sweep/zephyr/soc/intel/intel_socfpga_std/Kconfig.defconfig"
osource "/zmk-config-sweep/zephyr/soc/intel/intel_socfpga/Kconfig.defconfig"
osource "/zmk-config-sweep/zephyr/soc/intel/intel_niosv/Kconfig.defconfig"
osource "/zmk-config-sweep/zephyr/soc/intel/intel_ish/Kconfig.defconfig"
osource "/zmk-config-sweep/zephyr/soc/intel/intel_adsp/Kconfig.defconfig"
osource "/zmk-config-sweep/zephyr/soc/intel/elkhart_lake/Kconfig.defconfig"
osource "/zmk-config-sweep/zephyr/soc/intel/atom/Kconfig.defconfig"
osource "/zmk-config-sweep/zephyr/soc/intel/apollo_lake/Kconfig.defconfig"
osource "/zmk-config-sweep/zephyr/soc/intel/alder_lake/Kconfig.defconfig"
osource "/zmk-config-sweep/zephyr/soc/infineon/cat3/Kconfig.defconfig"
osource "/zmk-config-sweep/zephyr/soc/infineon/cat1b/Kconfig.defconfig"
osource "/zmk-config-sweep/zephyr/soc/infineon/cat1a/Kconfig.defconfig"
osource "/zmk-config-sweep/zephyr/soc/gd/gd32/Kconfig.defconfig"
osource "/zmk-config-sweep/zephyr/soc/gaisler/leon3/Kconfig.defconfig"
osource "/zmk-config-sweep/zephyr/soc/gaisler/gr716a/Kconfig.defconfig"
osource "/zmk-config-sweep/zephyr/soc/espressif/Kconfig.defconfig"
osource "/zmk-config-sweep/zephyr/soc/ene/kb1200/Kconfig.defconfig"
osource "/zmk-config-sweep/zephyr/soc/efinix/sapphire/Kconfig.defconfig"
osource "/zmk-config-sweep/zephyr/soc/cdns/xtensa_sample_controller/Kconfig.defconfig"
osource "/zmk-config-sweep/zephyr/soc/cdns/sample_controller32/Kconfig.defconfig"
osource "/zmk-config-sweep/zephyr/soc/cdns/dc233c/Kconfig.defconfig"
osource "/zmk-config-sweep/zephyr/soc/brcm/bcmvk/Kconfig.defconfig"
osource "/zmk-config-sweep/zephyr/soc/brcm/bcm2712/Kconfig.defconfig"
osource "/zmk-config-sweep/zephyr/soc/brcm/bcm2711/Kconfig.defconfig"
osource "/zmk-config-sweep/zephyr/soc/atmel/sam0/Kconfig.defconfig"
osource "/zmk-config-sweep/zephyr/soc/atmel/sam/Kconfig.defconfig"
osource "/zmk-config-sweep/zephyr/soc/aspeed/Kconfig.defconfig"
osource "/zmk-config-sweep/zephyr/soc/arm/Kconfig.defconfig"
osource "/zmk-config-sweep/zephyr/soc/arm/beetle/Kconfig.defconfig"
osource "/zmk-config-sweep/zephyr/soc/antmicro/myra/Kconfig.defconfig"
osource "/zmk-config-sweep/zephyr/soc/andestech/Kconfig.defconfig"
osource "/zmk-config-sweep/zephyr/soc/amd/acp_6_0/Kconfig.defconfig"
osource "/zmk-config-sweep/zephyr/soc/ambiq/Kconfig.defconfig"
osource "/zmk-config-sweep/zephyr/soc/altr/zephyr_nios2f/Kconfig.defconfig"
osource "/zmk-config-sweep/zephyr/soc/altr/qemu_nios2/Kconfig.defconfig"
osource "/zmk-config-sweep/zephyr/soc/adi/max32/Kconfig.defconfig"
```

## build/Kconfig/soc/Kconfig.soc
```kconfig
# Load SoC Kconfig descriptions.
osource "/zmk-config-sweep/zephyr/soc/xlnx/zynqmp/Kconfig.soc"
osource "/zmk-config-sweep/zephyr/soc/xlnx/zynq7000/Kconfig.soc"
osource "/zmk-config-sweep/zephyr/soc/xen/Kconfig.soc"
osource "/zmk-config-sweep/zephyr/soc/wch/ch32v/Kconfig.soc"
osource "/zmk-config-sweep/zephyr/soc/ti/simplelink/Kconfig.soc"
osource "/zmk-config-sweep/zephyr/soc/ti/lm3s6965/Kconfig.soc"
osource "/zmk-config-sweep/zephyr/soc/ti/k3/Kconfig.soc"
osource "/zmk-config-sweep/zephyr/soc/telink/tlsr/Kconfig.soc"
osource "/zmk-config-sweep/zephyr/soc/starfive/jh71xx/Kconfig.soc"
osource "/zmk-config-sweep/zephyr/soc/st/stm32/Kconfig.soc"
osource "/zmk-config-sweep/zephyr/soc/snps/qemu_arc/Kconfig.soc"
osource "/zmk-config-sweep/zephyr/soc/snps/nsim/arc_v/Kconfig.soc"
osource "/zmk-config-sweep/zephyr/soc/snps/nsim/arc_classic/Kconfig.soc"
osource "/zmk-config-sweep/zephyr/soc/snps/hsdk4xd/Kconfig.soc"
osource "/zmk-config-sweep/zephyr/soc/snps/hsdk/Kconfig.soc"
osource "/zmk-config-sweep/zephyr/soc/snps/emsk/Kconfig.soc"
osource "/zmk-config-sweep/zephyr/soc/snps/emsdp/Kconfig.soc"
osource "/zmk-config-sweep/zephyr/soc/snps/arc_iot/Kconfig.soc"
osource "/zmk-config-sweep/zephyr/soc/silabs/Kconfig.soc"
osource "/zmk-config-sweep/zephyr/soc/sifive/sifive_freedom/Kconfig.soc"
osource "/zmk-config-sweep/zephyr/soc/sensry/Kconfig.soc"
osource "/zmk-config-sweep/zephyr/soc/rockchip/Kconfig.soc"
osource "/zmk-config-sweep/zephyr/soc/renode/riscv_virtual/Kconfig.soc"
osource "/zmk-config-sweep/zephyr/soc/renode/cortex_r8_virtual/Kconfig.soc"
osource "/zmk-config-sweep/zephyr/soc/renesas/smartbond/Kconfig.soc"
osource "/zmk-config-sweep/zephyr/soc/renesas/rzt2m/Kconfig.soc"
osource "/zmk-config-sweep/zephyr/soc/renesas/rz/Kconfig.soc"
osource "/zmk-config-sweep/zephyr/soc/renesas/rcar/Kconfig.soc"
osource "/zmk-config-sweep/zephyr/soc/renesas/ra/Kconfig.soc"
osource "/zmk-config-sweep/zephyr/soc/realtek/ec/Kconfig.soc"
osource "/zmk-config-sweep/zephyr/soc/raspberrypi/rpi_pico/Kconfig.soc"
osource "/zmk-config-sweep/zephyr/soc/quicklogic/eos_s3/Kconfig.soc"
osource "/zmk-config-sweep/zephyr/soc/qemu/virt_riscv/Kconfig.soc"
osource "/zmk-config-sweep/zephyr/soc/qemu/malta/Kconfig.soc"
osource "/zmk-config-sweep/zephyr/soc/openisa/rv32m1/Kconfig.soc"
osource "/zmk-config-sweep/zephyr/soc/nxp/s32/Kconfig.soc"
osource "/zmk-config-sweep/zephyr/soc/nxp/rw/Kconfig.soc"
osource "/zmk-config-sweep/zephyr/soc/nxp/mcx/Kconfig.soc"
osource "/zmk-config-sweep/zephyr/soc/nxp/lpc/Kconfig.soc"
osource "/zmk-config-sweep/zephyr/soc/nxp/layerscape/Kconfig.soc"
osource "/zmk-config-sweep/zephyr/soc/nxp/kinetis/Kconfig.soc"
osource "/zmk-config-sweep/zephyr/soc/nxp/imxrt/Kconfig.soc"
osource "/zmk-config-sweep/zephyr/soc/nxp/imx/Kconfig.soc"
osource "/zmk-config-sweep/zephyr/soc/nuvoton/numicro/Kconfig.soc"
osource "/zmk-config-sweep/zephyr/soc/nuvoton/numaker/Kconfig.soc"
osource "/zmk-config-sweep/zephyr/soc/nuvoton/npcx/Kconfig.soc"
osource "/zmk-config-sweep/zephyr/soc/nuvoton/npcm/Kconfig.soc"
osource "/zmk-config-sweep/zephyr/soc/nordic/Kconfig.soc"
osource "/zmk-config-sweep/zephyr/soc/neorv32/Kconfig.soc"
osource "/zmk-config-sweep/zephyr/soc/native/inf_clock/Kconfig.soc"
osource "/zmk-config-sweep/zephyr/soc/microchip/miv/Kconfig.soc"
osource "/zmk-config-sweep/zephyr/soc/microchip/mec/Kconfig.soc"
osource "/zmk-config-sweep/zephyr/soc/mediatek/mt8xxx/Kconfig.soc"
osource "/zmk-config-sweep/zephyr/soc/lowrisc/opentitan/Kconfig.soc"
osource "/zmk-config-sweep/zephyr/soc/litex/litex_vexriscv/Kconfig.soc"
osource "/zmk-config-sweep/zephyr/soc/ite/ec/Kconfig.soc"
osource "/zmk-config-sweep/zephyr/soc/intel/raptor_lake/Kconfig.soc"
osource "/zmk-config-sweep/zephyr/soc/intel/lakemont/Kconfig.soc"
osource "/zmk-config-sweep/zephyr/soc/intel/intel_socfpga_std/Kconfig.soc"
osource "/zmk-config-sweep/zephyr/soc/intel/intel_socfpga/Kconfig.soc"
osource "/zmk-config-sweep/zephyr/soc/intel/intel_niosv/Kconfig.soc"
osource "/zmk-config-sweep/zephyr/soc/intel/intel_ish/Kconfig.soc"
osource "/zmk-config-sweep/zephyr/soc/intel/intel_adsp/Kconfig.soc"
osource "/zmk-config-sweep/zephyr/soc/intel/elkhart_lake/Kconfig.soc"
osource "/zmk-config-sweep/zephyr/soc/intel/atom/Kconfig.soc"
osource "/zmk-config-sweep/zephyr/soc/intel/apollo_lake/Kconfig.soc"
osource "/zmk-config-sweep/zephyr/soc/intel/alder_lake/Kconfig.soc"
osource "/zmk-config-sweep/zephyr/soc/infineon/cat3/Kconfig.soc"
osource "/zmk-config-sweep/zephyr/soc/infineon/cat1b/Kconfig.soc"
osource "/zmk-config-sweep/zephyr/soc/infineon/cat1a/Kconfig.soc"
osource "/zmk-config-sweep/zephyr/soc/gd/gd32/Kconfig.soc"
osource "/zmk-config-sweep/zephyr/soc/gaisler/leon3/Kconfig.soc"
osource "/zmk-config-sweep/zephyr/soc/gaisler/gr716a/Kconfig.soc"
osource "/zmk-config-sweep/zephyr/soc/espressif/Kconfig.soc"
osource "/zmk-config-sweep/zephyr/soc/ene/kb1200/Kconfig.soc"
osource "/zmk-config-sweep/zephyr/soc/efinix/sapphire/Kconfig.soc"
osource "/zmk-config-sweep/zephyr/soc/cdns/xtensa_sample_controller/Kconfig.soc"
osource "/zmk-config-sweep/zephyr/soc/cdns/sample_controller32/Kconfig.soc"
osource "/zmk-config-sweep/zephyr/soc/cdns/dc233c/Kconfig.soc"
osource "/zmk-config-sweep/zephyr/soc/brcm/bcmvk/Kconfig.soc"
osource "/zmk-config-sweep/zephyr/soc/brcm/bcm2712/Kconfig.soc"
osource "/zmk-config-sweep/zephyr/soc/brcm/bcm2711/Kconfig.soc"
osource "/zmk-config-sweep/zephyr/soc/atmel/sam0/Kconfig.soc"
osource "/zmk-config-sweep/zephyr/soc/atmel/sam/Kconfig.soc"
osource "/zmk-config-sweep/zephyr/soc/aspeed/Kconfig.soc"
osource "/zmk-config-sweep/zephyr/soc/arm/Kconfig.soc"
osource "/zmk-config-sweep/zephyr/soc/arm/beetle/Kconfig.soc"
osource "/zmk-config-sweep/zephyr/soc/antmicro/myra/Kconfig.soc"
osource "/zmk-config-sweep/zephyr/soc/andestech/Kconfig.soc"
osource "/zmk-config-sweep/zephyr/soc/amd/acp_6_0/Kconfig.soc"
osource "/zmk-config-sweep/zephyr/soc/ambiq/Kconfig.soc"
osource "/zmk-config-sweep/zephyr/soc/altr/zephyr_nios2f/Kconfig.soc"
osource "/zmk-config-sweep/zephyr/soc/altr/qemu_nios2/Kconfig.soc"
osource "/zmk-config-sweep/zephyr/soc/adi/max32/Kconfig.soc"
```
